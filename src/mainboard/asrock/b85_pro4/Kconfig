## src/mainboard/asrock/b85_pro4/Kconfig
```kconfig
## SPDX-License-Identifier: GPL-2.0-only

if BOARD_ASROCK_B85_PRO4

config BOARD_SPECIFIC_OPTIONS
	def_bool y
	select BOARD_ROMSIZE_KB_8192          # 8MB SPI flash
	select HAVE_ACPI_RESUME
	select HAVE_ACPI_TABLES
	select HAVE_CMOS_DEFAULT
	select HAVE_OPTION_TABLE
	select INTEL_GMA_HAVE_VBT
	select MAINBOARD_HAS_LIBGFXINIT
	select MAINBOARD_USES_IFD_GBE_REGION  # Use GbE  blob
	select MEMORY_MAPPED_TPM
	select NORTHBRIDGE_INTEL_HASWELL
	select SERIRQ_CONTINUOUS_MODE
	select SOUTHBRIDGE_INTEL_LYNXPOINT
	select SUPERIO_NUVOTON_NCT6776
	# Needed By Resizable BAR
	select PCIEXP_ASPM
	select PCIEXP_COMMON_CLOCK
	select PCIEXP_HOTPLUG
	select RESOURCE_ALLOCATION_TOP_DOWN
	select AZALIA_USE_LEGACY_VERB_TABLE

config CBFS_SIZE
	default 0x300000

config MAINBOARD_DIR
	string
	default "asrock/b85_pro4"

config MAINBOARD_PART_NUMBER
	string
	default "B85 Pro4"

config VGA_BIOS_ID
	string
	default "8086,0402"

config USBDEBUG_HCD_INDEX
	int
	default 2

endif
```

## src/mainboard/asrock/b85_pro4/Kconfig.name
```kconfig
## SPDX-License-Identifier: GPL-2.0-only

config BOARD_ASROCK_B85_PRO4
	bool "ASRock B85 Pro4"
```

## src/mainboard/asrock/b85_pro4/backup/Kconfig.name
```kconfig
## SPDX-License-Identifier: GPL-2.0-only

config BOARD_ASROCK_B85_PRO4
	bool "B85 Pro4"
```

## util/src/mainboard/to_be_filled_by_o.e.m/Kconfig
```kconfig
## SPDX-License-Identifier: GPL-2.0-only

if VENDOR_TO_BE_FILLED_BY_O.E.M

choice
	prompt "Mainboard model"

source "src/mainboard/to_be_filled_by_o.e.m/*/Kconfig.name"

endchoice

source "src/mainboard/to_be_filled_by_o.e.m/*/Kconfig"

config MAINBOARD_VENDOR
	string
	default "To Be Filled By O.E.M."

endif # VENDOR_TO_BE_FILLED_BY_O.E.M
```

## util/src/mainboard/to_be_filled_by_o.e.m/Kconfig.name
```kconfig
## SPDX-License-Identifier: GPL-2.0-only

config VENDOR_TO_BE_FILLED_BY_O.E.M
	bool "To Be Filled By O.E.M."
```

## util/src/mainboard/to_be_filled_by_o.e.m/to_be_filled_by_o.e.m/Kconfig
```kconfig
## SPDX-License-Identifier: GPL-2.0-only

if BOARD_TO_BE_FILLED_BY_O.E.M_TO_BE_FILLED_BY_O.E.M

config BOARD_SPECIFIC_OPTIONS
	def_bool y
	select AZALIA_USE_LEGACY_VERB_TABLE
	select BOARD_ROMSIZE_KB_8192
	select HAVE_ACPI_RESUME
	select HAVE_ACPI_TABLES
	select MAINBOARD_HAS_LIBGFXINIT # FIXME: check this
	select NORTHBRIDGE_INTEL_HASWELL
	select SERIRQ_CONTINUOUS_MODE
	select SOUTHBRIDGE_INTEL_LYNXPOINT

config MAINBOARD_DIR
	string
	default "to_be_filled_by_o.e.m/to_be_filled_by_o.e.m"

config MAINBOARD_PART_NUMBER
	string
	default "To Be Filled By O.E.M."

config VGA_BIOS_ID
	string
	default "8086,0402"

config USBDEBUG_HCD_INDEX # FIXME: check this
	int
	default 2
endif
```

## util/src/mainboard/to_be_filled_by_o.e.m/to_be_filled_by_o.e.m/Kconfig.name
```kconfig
## SPDX-License-Identifier: GPL-2.0-only

config BOARD_TO_BE_FILLED_BY_O.E.M_TO_BE_FILLED_BY_O.E.M
	bool "To Be Filled By O.E.M."
```
